~#include <dt-bindings/zmk/mouse.h>
#include <behaviors.dtsi>
#include <dt-bindings/zmk/bt.h>
#include <dt-bindings/zmk/keys.h>
#include <dt-bindings/zmk/pointing.h>
#include <dt-bindings/zmk/pointing.h>

#define MOUSE 4
#define SCROLL 5
~#define NUM 6
~#define ZMK_MOUSE_DEFAULT_SCRL_VAL 100
~
~&mt {
~    flavor = "balanced";
~    quick-tap-ms = <0>;
~};
~
~/ {
~    combos {
~        compatible = "zmk,combos";
~
~        end {
~            bindings = <&kp LS(LA(LC(F12)))>;
~            key-positions = <11 12 13 10>;
~            layers = <0>;
~        };
~
~        minas {
~            bindings = <&kp MINUS>;
~            key-positions = <8 9>;
~            layers = <0>;
~        };
~
~        prus {
~            bindings = <&kp PLUS>;
~            key-positions = <20 21>;
~            layers = <0>;
~        };
~
~        tab {
~            bindings = <&kp AMPERSAND>;
~            key-positions = <13 12>;
~            layers = <0>;
~        };
~
~        esc {
~            bindings = <&kp QUESTION>;
~            key-positions = <13 12 11>;
~            layers = <0>;
~        };
~
~        asuta {
~            bindings = <&kp ASTERISK>;
~            key-positions = <13 18>;
~            layers = <0>;
~            require-prior-idle-ms = <100>;
~        };
~
~        pa-sent {
~            bindings = <&kp PERCENT>;
~            key-positions = <20 19 18>;
~            layers = <0>;
~            require-prior-idle-ms = <5>;
~        };
~
~        ex {
~            bindings = <&kp EXCLAMATION>;
~            key-positions = <0 1>;
~            layers = <0>;
~        };
~
~        hash {
~            bindings = <&kp POUND>;
~            key-positions = <1 2 3>;
~            layers = <0>;
~        };
~
~        app {
~            bindings = <&kp UNDERSCORE>;
~            key-positions = <30 31 32>;
~            layers = <0>;
~        };
~
~        ent {
~            bindings = <&kp EQUAL>;
~            key-positions = <18 19>;
~        };
~
~        lkako {
~            bindings = <&kp LEFT_PARENTHESIS>;
~            key-positions = <24 25>;
~        };
~
~        rkako {
~            bindings = <&kp RIGHT_PARENTHESIS>;
~            key-positions = <30 31>;
~        };
~
~        koron {
~            bindings = <&kp COLON>;
~            key-positions = <24 25 23>;
~        };
~
~        dquo {
~            bindings = <&kp DOUBLE_QUOTES>;
~            key-positions = <18 19 20 21>;
~        };
~
~        delete {
~            bindings = <&kp DELETE>;
~            key-positions = <26 27>;
~        };
~
~        win1 {
~            bindings = <&kp LG(N1)>;
~            key-positions = <39 18>;
~        };
~
~        win2 {
~            bindings = <&kp LG(NUMBER_2)>;
~            key-positions = <39 19>;
~        };
~
~        win3 {
~            bindings = <&kp LG(NUMBER_3)>;
~            key-positions = <39 20>;
~        };
~
~        win5 {
~            bindings = <&kp LG(N5)>;
~            key-positions = <39 17>;
~        };
~
~        win6 {
~            bindings = <&kp LG(NUMBER_6)>;
~            key-positions = <39 30>;
~        };
~
~        win4 {
~            bindings = <&kp LG(NUMBER_4)>;
~            key-positions = <39 21>;
~        };
~    };
~
~    macros {
~        to_layer_0: to_layer_0 {
~            compatible = "zmk,behavior-macro-one-param";
~            #binding-cells = <1>;
~            bindings = <&to 0 &macro_param_1to1 &kp MACRO_PLACEHOLDER>;
~            label = "TO_LAYER_0";
~        };
~
~        kakko: kakko {
~            compatible = "zmk,behavior-macro";
~            #binding-cells = <0>;
~            bindings = <&kp LEFT_PARENTHESIS &kp RIGHT_PARENTHESIS>;
~            label = "KAKKO";
~        };
~
~        // 新しいスクロール動作の追加
~
~        scroll_up_down: behavior_sensor_rotate_mouse_wheel_up_down {
~            compatible = "zmk,behavior-sensor-rotate";
~            #sensor-binding-cells = <0>;
~            bindings = <&msc SCRL_UP>, <&msc SCRL_DOWN>;
~
~            // 追加: スクロールのタップ時間を設定 (20ms)
~
~            tap-ms = <20>;
~        };
~    };
~
~    behaviors {
~        lt_to_layer_0: lt_to_layer_0 {
~            compatible = "zmk,behavior-hold-tap";
~            label = "LAYER_TAP_TO_0";
~            bindings = <&mo>, <&to_layer_0>;
~
~            #binding-cells = <2>;
~            tapping-term-ms = <200>;
~        };
~    };
~
~    keymap {
~        compatible = "zmk,keymap";
~
~        default_layer {
~            bindings = <
~&kp Q             &kp W         &kp E         &kp R                      &kp T                                             &kp Y                     &kp U  &kp I      &kp O    &kp P
~&mt LEFT_SHIFT A  &kp S         &kp D         &lt 3 F                    &kp G        &kp LS(SPACE)    &kp MINUS           &kp H                     &kp J  &kp K      &kp L    &lt 4 SEMICOLON
~&kp Z             &kp X         &kp C         &kp V                      &kp B        &lt 4 SQT        &kp EQUAL           &kp N                     &kp M  &kp COMMA  &kp DOT  &kp SLASH
~&kp LCTRL         &kp LEFT_WIN  &kp LEFT_ALT  &lt_to_layer_0 2 LEFT_ALT  &lt 1 SPACE  &mt LCTRL F15    &mt LEFT_WIN ENTER  &mt LEFT_SHIFT BACKSPACE                             &kp LEFT_SHIFT
~            >;
~
~            sensor-bindings = <&scroll_up_down>;
~        };
~
~        SCROLL {
~            bindings = <
~&kp F4     &kp LC(W)  &kp LG(E)     &kp LC(R)  &kp LC(T)                             &kp GRAVE      &kp PAGE_UP       &kp UP_ARROW       &kp PAGE_DOWN  &trans
~&kp LC(A)  &kp LC(S)  &kp LEFT_ALT  &kp TAB    &kp ESC    &trans         &kp DOLLAR  &kp HOME       &kp LEFT          &kp DOWN           &kp RIGHT      &kp END
~&kp LC(Z)  &kp LC(X)  &kp LC(C)     &kp LC(V)  &kp K_APP  &kp AT_SIGN    &kp CARET   &kp BACKSLASH  &kp LEFT_BRACKET  &kp RIGHT_BRACKET  &trans         &trans
~&trans     &trans     &trans        &trans     &trans     &trans         &trans      &trans                                                             &trans
~            >;
~
~            sensor-bindings = <&inc_dec_kp LC(PAGE_UP) LC(PAGE_DOWN)>;
~        };
~
~        layer_6 {
~            bindings = <
~&trans           &trans           &trans           &trans           &trans                             &bt BT_SEL 0     &bt BT_SEL 1          &bt BT_SEL 2           &bt BT_SEL 3     &bt BT_SEL 4
~&kp KP_NUMBER_1  &kp KP_NUMBER_2  &kp KP_NUMBER_3  &kp KP_NUMBER_4  &kp KP_NUMBER_5  &trans    &trans  &kp KP_NUMBER_6  &kp KP_NUMBER_7       &kp KP_NUMBER_8        &kp KP_NUMBER_9  &kp KP_NUMBER_0
~&trans           &trans           &bootloader      &trans           &trans           &trans    &trans  &trans           &kp LEFT_PARENTHESIS  &kp RIGHT_PARENTHESIS  &trans           &trans
~&trans           &trans           &trans           &trans           &trans           &trans    &trans  &mo 5                                                                          &bt BT_CLR_ALL
~            >;
~        };
~
~        FUNCTION {
~            bindings = <
~&trans  &trans              &kp LG(UP_ARROW)  &trans         &trans                    &kp F1   &kp F2   &kp F3  &kp F4  &kp F5
~&trans  &kp LG(LEFT_ARROW)  &kp LG(DOWN)      &kp LG(RIGHT)  &trans  &trans    &trans  &kp F6   &kp F7   &kp F8  &kp F9  &kp F10
~&trans  &trans              &trans            &trans         &trans  &trans    &trans  &kp F12  &kp F12  &trans  &trans  &kp F11
~&trans  &trans              &trans            &trans         &trans  &trans    &trans  &trans                            &kp F12
~            >;
~
~            sensor-bindings = <&inc_dec_kp C_VOLUME_UP LC(LS(C_VOLUME_DOWN))>;
~        };
~
~        layer_4 {
~            bindings = <
~&bt BT_SEL 0  &bt BT_SEL 1  &bt BT_SEL 2    &bt BT_SEL 3  &bt BT_SEL 4                               &trans     &msc SCRL_UP  &trans     &msc SCRL_DOWN  &trans
~&trans        &trans        &kp LEFT_SHIFT  &kp LCTRL     &trans        &trans               &trans  &trans     &mkp MB1      &mkp MB2   &trans          &trans
~&trans        &trans        &trans          &trans        &kp LC(W)     &kp LA(LS(LCTRL))    &trans  &kp LC(X)  &kp LC(C)     &kp LC(V)  &trans          &trans
~&trans        &trans        &trans          &trans        &trans        &trans               &trans  &trans                                              &trans
~            >;
~        };
~
~        layer_5 {
~            bindings = <
~&trans            &trans            &trans            &trans            &trans                        &trans            &trans      &trans      &trans      &trans
~&kp LG(NUMBER_1)  &kp LG(NUMBER_2)  &kp LG(NUMBER_3)  &kp LG(NUMBER_4)  &kp LG(N5)  &trans    &trans  &kp LG(NUMBER_6)  &kp LG(N7)  &kp LG(N8)  &kp LG(N9)  &kp LG(N0)
~&trans            &trans            &trans            &trans            &trans      &trans    &trans  &trans            &trans      &trans      &trans      &trans
~&trans            &trans            &trans            &trans            &trans      &trans    &trans  &trans                                                &trans
~            >;
~        };
~    };
~};
